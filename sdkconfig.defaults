## sdkconfig.defaults
```kconfig
# Rust often needs a bit of an extra main task stack size compared to C (the default is 3K)
CONFIG_ESP_MAIN_TASK_STACK_SIZE=8192

# Use this to set FreeRTOS kernel tick frequency to 1000 Hz (100 Hz by default).
# This allows to use 1 ms granularity for thread sleeps (10 ms by default).
CONFIG_FREERTOS_HZ=1000

## Use tracing to check CPU usage and timing
## This makes bootup fail like:
## > ...
## > I (556) spi_flash: detected chip: generic
## > I (559) spi_flash: flash io: dio
## > W (564) i2c: This driver is an old driver, please migrate your application code to adapt `driver/i2c_master.h`
## > E (574) timer_group: CONFLICT! driver_ng is not allowed to be used with the legacy driver
## > E (582) segger_rtt: Failed to flush apptrace data (259)!
#CONFIG_APPTRACE_SV_ENABLE=y
#CONFIG_APPTRACE_DEST_JTAG=y

# Workaround for https://github.com/espressif/esp-idf/issues/7631
#CONFIG_MBEDTLS_CERTIFICATE_BUNDLE=n
#CONFIG_MBEDTLS_CERTIFICATE_BUNDLE_DEFAULT_FULL=n
```
